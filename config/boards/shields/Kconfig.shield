## config/boards/shields/Kconfig.shield
```kconfig
config SHIELD_PULSE_GRIP_LEFT
    def_bool $(shields_list_contains,pulse_grip_left)

config SHIELD_PULSE_GRIP_RIGHT
    def_bool $(shields_list_contains,pulse_grip_right)
```

## config/boards/shields/pulse_grip/Kconfig.defconfig
```kconfig
if SHIELD_PULSE_GRIP_LEFT

config ZMK_KEYBOARD_NAME
    default "Pulse Grip"

config ZMK_SPLIT_ROLE_CENTRAL
    default y

endif

if SHIELD_PULSE_GRIP_LEFT || SHIELD_PULSE_GRIP_RIGHT

config ZMK_SPLIT
    default y

endif
```
